## boards/shields/dongle_display/Kconfig.defconfig
```kconfig
# Copyright (c) 2024 The ZMK Contributors
# SPDX-License-Identifier: MIT

if SHIELD_DONGLE_DISPLAY

choice ZMK_DISPLAY_STATUS_SCREEN
    default ZMK_DISPLAY_STATUS_SCREEN_CUSTOM
endchoice

config ZMK_DISPLAY_STATUS_SCREEN_CUSTOM
    select LV_USE_LABEL
    select LV_USE_IMAGE
    select LV_USE_CANVAS
    select LV_USE_ANIMIMG 
    select LV_USE_ANIMATION
    select LV_USE_LINE 
    select LV_FONT_UNSCII_8
    select ZMK_WPM
    imply ZMK_HID_INDICATORS

config ZMK_DONGLE_DISPLAY_DONGLE_BATTERY
    bool "Show also the battery level of the dongle"
    depends on BT && (!ZMK_SPLIT_BLE || ZMK_SPLIT_ROLE_CENTRAL)

config ZMK_DONGLE_DISPLAY_NAME
    string "display device name on screen"

config ZMK_DONGLE_DISPLAY_MAC_MODIFIERS
    bool "Use MacOS modifier symbols instead of the Windows symbols"

config ZMK_DONGLE_DISPLAY_PADDING_LEFT
    int "Left padding for widgets in pixels"
    default 0
    range 0 20

config ZMK_DONGLE_DISPLAY_PADDING_RIGHT
    int "Right padding for widgets in pixels"
    default 0
    range 0 20

config ZMK_DONGLE_DISPLAY_ANIMATION_EXTENSION
    bool "Enable the generic multi-animation engine"
    default n

config ZMK_DONGLE_DISPLAY_CUSTOM_ANIMATION_PROVIDER
    bool "Use an animation provider from ZMK_CONFIG"
    default n
    select ZMK_DONGLE_DISPLAY_ANIMATION_EXTENSION

config ZMK_DONGLE_DISPLAY_ANIMATION_PROVIDER_HEADER
    string "Animation provider header relative to ZMK_CONFIG"
    default ""
    depends on ZMK_DONGLE_DISPLAY_CUSTOM_ANIMATION_PROVIDER

config ZMK_DONGLE_DISPLAY_ANIMATION_PROVIDER_GENERATED
    bool "Generate the animation provider during the build"
    default n
    depends on ZMK_DONGLE_DISPLAY_CUSTOM_ANIMATION_PROVIDER

config ZMK_DONGLE_DISPLAY_ANIMATION_PROVIDER_GENERATOR
    string "Provider generator relative to ZMK_CONFIG"
    default ""
    depends on ZMK_DONGLE_DISPLAY_ANIMATION_PROVIDER_GENERATED

config ZMK_DONGLE_DISPLAY_ANIMATION_PROVIDER_GENERATOR_ARGS
    string "Provider generator arguments"
    default ""
    depends on ZMK_DONGLE_DISPLAY_ANIMATION_PROVIDER_GENERATED

config ZMK_DONGLE_DISPLAY_ANIMATION_PROVIDER_CACHE_DIR
    string "Generated provider cache directory relative to ZMK_CONFIG"
    default "../.build/_graphs"
    depends on ZMK_DONGLE_DISPLAY_ANIMATION_PROVIDER_GENERATED

config ZMK_DONGLE_DISPLAY_ANIMATION_ROM_MAX_BYTES
    int "Optional maximum total linked ROM bytes with custom animations"
    default 0
    range 0 2147483647
    depends on ZMK_DONGLE_DISPLAY_CUSTOM_ANIMATION_PROVIDER
    help
      When nonzero, fail the final link if complete firmware ROM usage exceeds
      this empirical startup-safety budget. This limits the linked image as a
      whole, not merely the generated animation bitmap payload. Set this to
      zero to disable the guard for unrestricted capacity or optimization
      testing.

config ZMK_DONGLE_DISPLAY_ANIMATION_ROTATE_ON_WAKE
    bool "Request the next animation pack after display wake"
    default n
    depends on ZMK_DONGLE_DISPLAY_ANIMATION_EXTENSION

choice ZMK_DISPLAY_WORK_QUEUE
    default ZMK_DISPLAY_WORK_QUEUE_DEDICATED
endchoice

config LV_Z_MEM_POOL_SIZE
    default 8192

config LV_Z_VDB_SIZE
    default 64

config LV_DPI_DEF
    default 148

config LV_Z_BITS_PER_PIXEL
    default 1

choice LV_COLOR_DEPTH
    default LV_COLOR_DEPTH_1
endchoice

endif
```

## dts/bindings/behaviors/zmk,behavior-dongle-animation-next.yaml
```yaml
description: Request the next animation pack on the dongle display

compatible: "zmk,behavior-dongle-animation-next"

include: zero_param.yaml
```

## dts/bindings/behaviors/zmk,behavior-fighter-next.yaml
```yaml
description: Request the next fighter on the dongle display

compatible: "zmk,behavior-fighter-next"

include: zero_param.yaml
```
